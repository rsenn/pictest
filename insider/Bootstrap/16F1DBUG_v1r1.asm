;*******************************************************
; 16F1DBUG: -- DEBUG INSIDER -- TARGET ROUTINE VR 1.1
; ATANASIOS MELIMOPOULOS (pic.insider@gmail.com)
; 12F1xxx AND 16F1xxx ENHANCED SERIES < 2K PROG-WORDS

;************** PLACE DEBUG ON/OFF MACRO AT USER-PROG-START

DBRK	EQU	1	;SET BREAKPOINTS-DEBUG ON/OFF 1/0
DBEE	EQU	1	;SET EEPROM-READ-CMD   ON/OFF 1/0
 noexpand

BREAK	MACRO	bkn	;BREAKPOINT MACRO DEF
 IF DBRK==1
	MOVWF	DB0
	MOVLW	bkn
	CALL	DBUG
 ENDIF
	ENDM


;************** PLACE AT BREAKPOINT ADR:

	BREAK	nn	;BREAKPOINT NUMBER: 00H-0FFH


;************** REPLACE DBUG LABEL/VAR NAMES IF USED BY THE USER-PROG
;************** PLACE DBUG-DATA-ADR AT 16F1xxx UNUSED BANK-0 DATA AREA
;************** PLACE THE FOLLOWING CODE AT THE END OF THE USER-PROG

 IF DBRK==1	;16F1DBUG: -- DEBUG INSIDER -- TARGET ROUTINE VR 1.1
 NOLIST
DB0	EQU	7FH	;COMMON ACCESS AREA
DB1	EQU	7EH	;COMMON ACCESS AREA
DB2	EQU	7DH	;COMMON ACCESS AREA
DB3	EQU	6FH	;BANK0
DB4	EQU	6EH	;BANK0
DB5	EQU	6DH	;BANK0
DB6	EQU	6CH	;BANK0

;************** USER-PROG INITIALIZED DEBUG PIN/PORT FOR DIGITAL I/O
#DEFINE X	PORTA,1	;DEBUG PORT    -- USER SELECTED CPU PORT-REG-PIN
#DEFINE T	TRISA,1	;TRIS REG NAME -- USER SELECTED CPU TRIS-REG-PIN
DBN	EQU	.1	;SPEED MULTIPLIER: 1x, 2x, 4x, 8x, 16x

ENDPROG	EQU	800H	   ;USER SELECTED END-PROG-MEM - CHECK CPU TYPE -

	ORG	ENDPROG-.179
 IF DBEE
 IFDEF	EECON1
	ORG	ENDPROG-.198
 ENDIF
 ENDIF

DBUG	MOVWF	DB1
	MOVF	STATUS,W
	MOVWF	DB2
	MOVF	BSR,W
	MOVLB	0
	MOVWF	DB6
	MOVF	INTCON,W
	BCF	INTCON,GIE
	MOVWF	DB5
	MOVF	FSR0H,W
	MOVWF	DB4
	MOVF	FSR0L,W
	MOVWF	DB3
DG001	BSF	X
	MOVLB	1
	BCF	T
	MOVLB	0
	MOVLW	.251
	MOVWF	FSR0H
	CALL	DG003
	RLF	DB1
	GOTO	DG006
DG002	RRF	DB1
	MOVLW	.258-.127/DBN
	BTFSS	STATUS,C
DG003	MOVLW	.258-.63/DBN
	ADDLW	1
	BTFSS	STATUS,Z
	GOTO	$-2
DG004	RETURN
DG005	CALL	DG002
DG006	BCF	X
	CALL	DG004
	CALL	DG002
	BSF	X
	CLRWDT
	INCFSZ	FSR0H
	GOTO	DG005
DG007	MOVLB	1
	BSF	T
	CALL	DG022
	BTFSS	DB1,7
	GOTO	DG012
	BTFSC	DB1,6
	GOTO	DG010
	BTFSS	DB1,5
	GOTO	DG008
	CALL	DG009
	MOVWF	DB0
	MOVLW	0FFH
	GOTO	DBUG
DG008	BTFSS	DB1,4
	GOTO	DG011
	MOVLW	DBN
	GOTO	DG021
DG009
	BANKSEL	STKPTR
	INCF	STKPTR
DG010	CALL	DG022
	MOVF	DB1,W
	BANKSEL	TOSH
	MOVWF	TOSH
	CALL	DG022
	MOVF	DB1,W
	BANKSEL	TOSL
	MOVWF	TOSL
	MOVLB	0
DG011	MOVF	DB3,W
	MOVWF	FSR0L
	MOVF	DB4,W
	MOVWF	FSR0H
	MOVF	DB5,W
	MOVWF	INTCON
	MOVF	DB6,W
	MOVWF	BSR
	MOVF	DB2,W
	MOVWF	STATUS
	SWAPF	DB0
	SWAPF	DB0,W
	RETURN
DG012	BTFSC	DB1,4
	BTFSS	DB1,5
	GOTO	DG013
	CALL	DG022
 IF DBEE
 IFDEF	EECON1
	BANKSEL	EECON1
	MOVF	EEADRL,W
	MOVWF	FSR0L
	MOVF	EEDATL,W
	MOVWF	FSR0H
	MOVF	DB1,W
	MOVWF	EEADRL
	MOVF	EECON1,W
	BCF	EECON1,7
	BCF	EECON1,6
	BSF	EECON1,0
	MOVWF	EECON1
	MOVF	EEDATL,W
	MOVWF	DB1
	MOVF	FSR0H,W
	MOVWF	EEDATL
	MOVF	FSR0L,W
	MOVWF	EEADRL
	MOVLB	0
 ENDIF
 ENDIF
	GOTO	DG001
DG013	MOVF	DB1,W
	MOVWF	FSR0L
	ANDLW	0FH
	MOVWF	FSR0H
	BTFSC	DB1,4
	GOTO	DG014
	BTFSC	DB1,5
	GOTO	DG015
	CALL	DG022
	MOVLW	7FH
	ANDWF	DB1,W
	XORLW	LOW WREG
	BTFSS	STATUS,Z
	GOTO	$+3
DG014	MOVLW	LOW DB0	
	GOTO	DG016
	XORLW	LOW STATUS^LOW WREG
	BTFSS	STATUS,Z
	GOTO	$+3
DG015	MOVLW	LOW DB2
	GOTO	DG016
	XORLW	LOW FSR0L^LOW STATUS
	BTFSS	STATUS,Z
	GOTO	$+3
	MOVLW	LOW DB3
	GOTO	DG016
	XORLW	LOW FSR0H^LOW FSR0L
	BTFSS	STATUS,Z
	GOTO	$+3
	MOVLW	LOW DB4
	GOTO	DG016
	XORLW	LOW INTCON^LOW FSR0H
	BTFSS	STATUS,Z
	GOTO	$+3
	MOVLW	LOW DB5
	GOTO	DG016
	XORLW	LOW BSR^LOW INTCON
	BTFSS	STATUS,Z
	GOTO	$+4
	MOVLW	LOW DB6
DG016	CLRF	FSR0H
	GOTO	DG019
	XORLW	LOW DB0^LOW BSR
	BTFSS	STATUS,Z
	XORLW	LOW DB2^LOW DB0
	BTFSC	STATUS,Z
	GOTO	DG017
	MOVF	FSR0H
	BTFSC	STATUS,Z
	BTFSC	DB1,7
	GOTO	DG018
	XORLW	LOW DB3^LOW DB2
	BTFSS	STATUS,Z
	XORLW	LOW DB4^LOW DB3
	BTFSS	STATUS,Z
	XORLW	LOW DB5^LOW DB4
	BTFSS	STATUS,Z
	XORLW	LOW DB6^LOW DB5
DG017	MOVLW	LOW DB1
	BTFSS	STATUS,Z
DG018	MOVF	DB1,W
DG019	BTFSS	FSR0L,6
	GOTO	DG020
	MOVWF	FSR0L
	CALL	DG022
	MOVF	DB1,W
	MOVWF	INDF0
	GOTO	DG007
DG020	MOVWF	FSR0L
	MOVF	INDF0,W
DG021	MOVWF	DB1
	GOTO	DG001
DG022	MOVLB	0
	CLRF	DB1
	CLRWDT
	BTFSC	X
	GOTO	$-2
	GOTO	DG024
DG023	CLRW
	CLRWDT
	ADDLW	1
	BTFSC	X
	GOTO	$-3
	ADDLW	.256-.78/DBN
	RRF	DB1
DG024	CLRW
	CLRWDT
	ADDLW	1
	BTFSS	X
	GOTO	$-3
	ADDLW	.256-.78/DBN
	RRF	DB1
	BTFSS	STATUS,C
	GOTO	DG023
	RETURN
 LIST
 ENDIF
