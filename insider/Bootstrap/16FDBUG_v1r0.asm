;
*******************************************************;
16FDBUG : --DEBUG INSIDER-- TARGET ROUTINE VR 1.0;
ATANASIOS MELIMOPOULOS(pic.insider @gmail.com);
16Fxxx < 2K PROG - WORDS

    ;
**************PLACE DEBUG ON / OFF MACRO AT USER - PROG -
    START

        DBRK EQU 1;
SET BREAKPOINTS - DEBUG ON / OFF 1 / 0 DBEE EQU 1;
SET EEPROM - READ -
    CMD ON / OFF 1 /
        0 noexpand

            BREAK MACRO bkn;
BREAKPOINT MACRO DEF IF DBRK == 1 MOVWF DB0 MOVLW bkn CALL DBUG ENDIF ENDM

    ;
**************PLACE AT BREAKPOINT ADR :

    BREAK nn;
BREAKPOINT NUMBER : 00H - 0FFH

    ;
**************REPLACE DBUG LABEL / VAR NAMES IF USED BY THE USER - PROG;
**************PLACE DBUG - DATA - ADR AT 16Fxxx UNUSED BANK - 0 DATA AREA;
**************PLACE THE FOLLOWING CODE AT THE END OF THE USER - PROG

                                                                    IF DBRK ==
    1;
16FDBUG : --DEBUG INSIDER-- TARGET ROUTINE VR 1.0 NOLIST DB0 EQU 7FH;
COMMON ACCESS AREA DB1 EQU 7EH;
COMMON ACCESS AREA DB2 EQU 6FH;
BANK0
DB3 EQU 6EH;
BANK0
DB4 EQU 6DH;
BANK0

    ;
**************USER - PROG INITIALIZED DEBUG PIN / PORT FOR DIGITAL I /
                         O
#DEFINE X PORTA, 1; DEBUG PORT-- USER SELECTED CPU PORT - REG - PIN
#DEFINE T TRISA, 1; TRIS REG NAME-- USER SELECTED CPU TRIS - REG - PIN
                             DBN EQU .1;
SPEED MULTIPLIER : (1x),
                   2x,
                   4x,
                   8x,
                   16x

                   ENDPROG EQU 800H;
USER SELECTED END - PROG - MEM - CHECK CPU TYPE - ;
-----BE CAREFUL WITH OSCCAL / CONFIG BYTE AT THE END OF PROG -
    MEM-- -----

    ORG ENDPROG -
    .115 IF DBEE IFDEF EECON1 ORG ENDPROG -
    .139 ENDIF ENDIF

        DBUG MOVWF DB1 MOVF STATUS,
    W CLRF STATUS MOVWF DB2 MOVF INTCON, W BCF INTCON, GIE MOVWF DB4 MOVF FSR, W MOVWF DB3 DG001 BSF X BSF STATUS,
    RP0 BCF T CLRF STATUS MOVLW .251 MOVWF FSR CALL DG003 RLF DB1 GOTO DG006 DG002 RRF DB1 MOVLW .258 -
        .127 / DBN BTFSS STATUS,
    C DG003 MOVLW .258 - .63 / DBN ADDLW 1 BTFSS STATUS,
    Z GOTO $ - 2 DG004 RETURN DG005 CALL DG002 DG006 BCF X CALL DG004 CALL DG002 BSF X NOP INCFSZ FSR GOTO DG005 DG007
                   BSF STATUS,
    RP0 BSF T CLRF STATUS CALL DG014 BTFSS DB1, 7 GOTO DG008 MOVLW DBN BTFSC DB1, 4 GOTO DG013 MOVF DB3,
    W MOVWF FSR MOVF DB4, W MOVWF INTCON MOVF DB2, W MOVWF STATUS SWAPF DB0 SWAPF DB0, W RETURN DG008 BTFSC DB1,
    4 BTFSS DB1, 5 GOTO DG009 CALL DG014 IF DBEE IFDEF EECON1 BANKSEL EEADR MOVF EEADR, W MOVWF FSR MOVF DB1,
    W MOVWF EEADR MOVF EEDATA, W MOVWF DB1 BANKSEL EECON1 MOVF EECON1, W BCF EECON1, 7 BSF EECON1,
    0 MOVWF EECON1 BANKSEL EEADR MOVF EEDATA, W XORWF DB1 XORWF DB1, W XORWF DB1 MOVWF EEDATA MOVF FSR,
    W MOVWF EEADR CLRF STATUS ENDIF ENDIF GOTO DG001 DG009 MOVF DB1, W MOVWF FSR MOVLW DB0 BTFSC DB1,
    4 GOTO DG011 BTFSC DB1, 5 GOTO DG010 CALL DG014 MOVLW 7FH ANDWF DB1, W XORLW STATUS BTFSS STATUS,
    Z GOTO $ + 3 DG010 MOVLW DB2 GOTO DG011 XORLW FSR ^ STATUS BTFSS STATUS,
    Z GOTO $ + 3 MOVLW DB3 GOTO DG011 XORLW INTCON ^ FSR BTFSS STATUS, Z GOTO $ + 3 MOVLW DB4 GOTO DG011 BTFSC FSR,
    0 BSF STATUS, IRP MOVF DB1, W DG011 BTFSS FSR, 6 GOTO DG012 MOVWF FSR CALL DG014 MOVF DB1,
    W MOVWF INDF GOTO DG007 DG012 MOVWF FSR MOVF INDF,
    W DG013 MOVWF DB1 GOTO DG001 DG014 CLRF DB1 BTFSC X GOTO $ - 1 GOTO DG016 DG015 CLRW ADDLW 1 BTFSC X GOTO $ -
        2 ADDLW .256 - .96 / DBN RRF DB1 DG016 CLRW ADDLW 1 BTFSS X GOTO $ - 2 ADDLW .256 -
        .96 / DBN RRF DB1 BTFSS STATUS,
    C GOTO DG015 RETURN LIST ENDIF
