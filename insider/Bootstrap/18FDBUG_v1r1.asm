;*******************************************************
; 18FDBUG: --- DEBUG INSIDER -- TARGET ROUTINE VR 1.1
; ATANASIOS MELIMOPOULOS (pic.insider@gmail.com)

;************** PLACE DEBUG ON/OFF MACRO AT USER-PROG-START

DBRK	EQU	1	;SET BREAKPOINTS-DEBUG ON/OFF 1/0
 noexpand

BREAK	MACRO	bkn	;BREAKPOINT MACRO DEF
 IF DBRK==1
	MOVFF	WREG,DB0
	MOVLW	bkn
	CALL	DBUG
 ENDIF
	ENDM


;************** PLACE AT BREAKPOINT ADR:

	BREAK	nn	;BREAKPOINT NUMBER: 00H-0FFH


;************** REPLACE DBUG LABEL/VAR NAMES IF USED BY THE USER-PROG
;************** PLACE DBUG-DATA-ADR-GROUP AT ANY SPARE ADR-BANK
;************** PLACE THE FOLLOWING CODE AT THE END OF THE USER-PROG

 IF DBRK==1	;18FDBUG: -- DEBUG INSIDER -- TARGET ROUTINE VR 1.1
 NOLIST
DB0	EQU	0F7FH
DB1	EQU	0F7EH
DB2	EQU	0F7DH
DB3	EQU	0F7CH
DB4	EQU	0F7BH
DB5	EQU	0F7AH

;************** USER-PROG DEBUG PIN/PORT INITIALIZED FOR DIGITAL I/O
#DEFINE X	PORTD,2		;DEBUG PORT    -- USER SELECTED CPU PORT-REG-PIN
#DEFINE T	TRISD,2		;TRIS REG NAME -- USER SELECTED CPU TRIS-REG-PIN
DBN		EQU	.1	;SPEED MULTIPLIER: 1x, 2x, 4x, 8x, 16x

	ORG	0x10000-.378	;USER SELECTED END_PROG_MEM - DBUG(BYTES)
;CHECK CPU TYPE - BE CAREFUL WITH CONFIG-BYTES AT THE END OF PROG-MEM


DBUG	MOVFF	INTCON,DB1
	BCF	INTCON,GIE
	MOVFF	STATUS,DB2
	MOVFF	FSR0L,DB3
	MOVFF	FSR0H,DB4
DG001	MOVWF	FSR0L
	BSF	X
	BCF	T
	MOVLW	.10
	MOVWF	FSR0H
	RCALL	DG003
	RLCF	FSR0L
	BRA	DG005
DG002	RRCF	FSR0L
	MOVLW	.258-.127/DBN
	BTFSS	STATUS,C
DG003	MOVLW	.258-.63/DBN
	CLRWDT
	ADDLW	1
	BNZ	$-4
	RETURN
DG004	RCALL	DG002
DG005	BTG	X
	CLRWDT
	DECFSZ	FSR0H
	BRA	DG004
DG006	BSF	T
	RCALL	DG024
	BTFSS	FSR0L,7
	BRA	DG011
	BTFSC	FSR0L,6
	BRA	DG009
	BTFSS	FSR0L,5
	BRA	DG007
	RCALL	DG008
	MOVFF	WREG,DB0
	MOVLW	0FFH
	BRA	DBUG
DG007	BTFSS	FSR0L,4
	BRA	DG010
	MOVLW	DBN
	BRA	DG001
DG008	INCF	STKPTR
DG009	MOVF	FSR0L,W
	MOVWF	TOSU
	RCALL	DG024
	MOVF	FSR0L,W	
	MOVWF	TOSH
	RCALL	DG024
	BCF	FSR0L,0
	MOVF	FSR0L,W
	MOVWF	TOSL
DG010	MOVFF	DB0,WREG
	MOVFF	DB4,FSR0H
	MOVFF	DB3,FSR0L
	MOVFF	DB2,STATUS
	MOVFF	DB1,INTCON
	RETURN
DG011	MOVFF	FSR0L,DB5
	BTFSC	FSR0L,4
	BTFSS	FSR0L,5
	BRA	DG012
	RCALL	DG024
 IFDEF	EEADRH
	MOVFF	EEADRH,FSR0H
	MOVFF	DB5,EEADRH
 ELSE
	NOP
	NOP
	NOP
	NOP
 ENDIF
	MOVFF	EEADR,DB5
	MOVFF	FSR0L,EEADR
	MOVFF	EEDATA,FSR0L
	MOVF	EECON1,W
	BCF	EECON1,7
	BCF	EECON1,6
	BSF	EECON1,0
	MOVWF	EECON1
 IFDEF	EEADRH
	MOVFF	FSR0H,EEADRH
 ELSE
	NOP
	NOP
 ENDIF
	MOVFF	DB5,EEADR
	MOVF	EEDATA,W
	MOVFF	FSR0L,EEDATA
	BRA	DG001
DG012	BTFSC	FSR0L,4
	BRA	DG013
	BTFSC	FSR0L,5
	BRA	DG015
	RCALL	DG024
	MOVFF	DB5,WREG
	XORLW	HIGH WREG
	ANDLW	0FH
	BNZ	DG019
	MOVF	FSR0L,W
	XORLW	LOW WREG
	BNZ	DG014
DG013	MOVLW	LOW DB0
	BRA	DG021
DG014	XORLW	LOW STATUS^LOW WREG
	BNZ	DG016
DG015	MOVLW	LOW DB2
	BRA	DG021
DG016	XORLW	LOW INTCON^LOW STATUS
	BNZ	DG017
	MOVLW	LOW DB1
	BRA	DG021
DG017	XORLW	LOW FSR0L^LOW INTCON
	BNZ	DG018
	MOVLW	LOW DB3
	BRA	DG021
DG018	XORLW	LOW FSR0H^LOW FSR0L
	BNZ	DG019
	MOVLW	LOW DB4
	BRA	DG021
DG019	MOVFF	DB5,WREG
	XORLW	HIGH DB0
	ANDLW	0FH
	BNZ	DG022
	MOVF	FSR0L,W
	XORLW	LOW DB0
	BZ	DG020
	XORLW	LOW DB1^LOW DB0
	BZ	DG020
	XORLW	LOW DB2^LOW DB1
	BZ	DG020
	XORLW	LOW DB3^LOW DB2
	BZ	DG020
	XORLW	LOW DB4^LOW DB3
	BNZ	DG022
DG020	MOVLW	LOW DB5
DG021	MOVWF	FSR0L
	MOVFF	DB5,WREG
	ANDLW	0F0H
	IORLW	HIGH DB5
	MOVFF	WREG,DB5
DG022	MOVFF	DB5,FSR0H
	MOVFF	DB5,WREG
	BTFSS	WREG,6
	BRA	DG023
	MOVFF	FSR0L,DB5
	RCALL	DG024
	MOVF	FSR0L,W
	MOVFF	DB5,FSR0L
	MOVWF	INDF0
	BRA	DG006
DG023	MOVF	INDF0,W
	BRA	DG001
DG024	CLRF	FSR0L
	CLRWDT
	BTFSC	X
	BRA	$-4
	BRA	DG026
DG025	CLRF	WREG
	CLRWDT
	ADDLW	1
	BTFSC	X
	BRA	$-6
	ADDLW	.256-.78/DBN
	RRCF	FSR0L
DG026	CLRF	WREG
	CLRWDT
	ADDLW	1
	BTFSS	X
	BRA	$-6
	ADDLW	.256-.78/DBN
	RRCF	FSR0L
	BNC	DG025
	RETURN	
 LIST
 ENDIF
