;PROGRAM DEMO_18F4620

 LIST P=18F4620, st=OFF
 #include <P18F4620.INC>
 errorlevel	-302
 errorlevel	-305
 radix	dec

 CONFIG	OSC = INTIO7, MCLRE = OFF, PBADEN = OFF, LVP = OFF, WDT = OFF, PWRT = ON


DBRK	EQU	1	;SET BREAKPOINTS-DEBUG ON/OFF 1/0
 noexpand

BREAK	MACRO	bkn	;BREAKPOINT MACRO DEF
 IF DBRK==1
	MOVFF	WREG,DB0
	MOVLW	bkn
	CALL	DBUG
 ENDIF
	ENDM


;************************************************************************
; DEMO PROGRAM THAT LOADS BYTE 11H TO DATA RAM ADDRESS 0F0H-10FH,
; BYTE 22H TO 1F0H-20FH, BYTE 33H TO 2F0H-30FH, BYTE 44H TO 3F0H-40FH
; BYTE 55H TO 4F0H-50FH, BYTE 66H TO 5F0H-60FH, BYTE 77H TO 6F0H-70FH
; BYTE 88H TO 7F0H-80FH, BYTE 99H TO 8F0H-90FH, BYTE AAH TO 9F0H-A0FH
; BYTE BBH TO AF0H-B0FH, BYTE CCH TO BF0H-C0FH, BYTE DDH TO CF0H-D0FH
; BYTE EEH TO DF0H-E0FH, BYTE FFH TO EF0H-F0FH.
; TO TEST THE INSIDER DISPLAY (D cmd)
; THEN THERE IS LOOP WHERE PORTB BITS:4-5-6-7 CONNECTED TO 4x PUSHBUTTONS ARE
; READ AND IF ANY IS PRESSED (0-INPUT) THE CORRESPONDING LED CONNECTED TO
; PORTB 0-1-2-3 IS TURNED ON.

VAR1	EQU	20H
VAR2	EQU	21H
DLYH	EQU	22H
DLYL	EQU	23H

;**************************************************************

	ORG	00H

;	BSF	OSCTUNE,7	;SET INTOSC/256

	MOVLW	70H		;8MHz
;	MOVLW	60H		;4MHz
;	MOVLW	10H		;125KHz
;	MOVLW	00H		;32.5KHz
	MOVWF	OSCCON		;SET INTERNAL CLOCK DIVIDER

;SELECT ONE OF THE ABOVE TO CHOOSE BETWEEN 4MHz OR 8MHZ
;IF NONE IS SELECTED THEN 1MHz IS THE DEFAULT VALUE

	BSF	OSCTUNE,PLLEN	;4XCLOCK MODE, COMMENT THIS 2-LINES IF YOU WANT 1X

LBLX	BTFSS	OSCCON,OSTS
	BRA	LBLX
LBLY	BTFSS	OSCCON,IOFS
	BRA	LBLY

	RCALL	DL1MS		;ALLOWS 4xPLL TO SETTLE

	MOVLW	0F0H
	MOVWF	TRISB		;RB7-4 INPUT, RB3-0 OUTPUT

;**************************** TEST OUTPUT SERIAL STRING


	MOVLW	0FFH
	MOVWF	PORTB		;INIT PORT '1'

	LFSR	0,0F0H
	MOVLW	11H
	RCALL	SAVEF
	LFSR	0,1F0H
	MOVLW	22H
	RCALL	SAVEF
	LFSR	0,2F0H
	MOVLW	33H
	RCALL	SAVEF
	LFSR	0,3F0H
	MOVLW	44H
	RCALL	SAVEF
	LFSR	0,4F0H


	BREAK	20H		;BREAK HERE TO CHECK THE DATA RAM WITH 
				;INSIDER cmd: DF0.10F 2F0.30F 7F0.80F BF0.C0F(CR)


	MOVLW	55H
	RCALL	SAVEF
	LFSR	0,5F0H
	MOVLW	66H
	RCALL	SAVEF
	LFSR	0,6F0H
	MOVLW	77H
	RCALL	SAVEF
	LFSR	0,7F0H
	MOVLW	88H
	RCALL	SAVEF
	LFSR	0,8F0H
	MOVLW	99H
	RCALL	SAVEF
	LFSR	0,9F0H
	MOVLW	0AAH
	RCALL	SAVEF
	LFSR	0,0AF0H
	MOVLW	0BBH
	RCALL	SAVEF
	LFSR	0,0BF0H
	MOVLW	0CCH
	RCALL	SAVEF
	LFSR	0,0CF0H
	MOVLW	0DDH
	RCALL	SAVEF
	LFSR	0,0DF0H
	MOVLW	0EEH
	RCALL	SAVEF
	LFSR	0,0EF0H
	MOVLW	0FFH
	RCALL	SAVEF

LBL1	MOVF	PORTB,W		;READ  KEY PRESS -> BIT 4-7


	BREAK	21H		;BREAK HERE TO CHECK THE DATA RAM WITH 
				;INSIDER cmd: D(CR)


	MOVWF	VAR1,A
	IORLW	0FH
	XORLW	0FFH
	BZ	LBL1


	BREAK	31H		;BREAK HERE AFTER ANY KEY PRESSED IN W



	MOVLW	0FFH
	MOVWF	VAR2,A		;SET VAR2-> FFH
	BTFSS	VAR1,4,A	;SET LEDS
	BCF	VAR2,0,A
	BTFSS	VAR1,5,A
	BCF	VAR2,1,A
	BTFSS	VAR1,6,A
	BCF	VAR2,2,A
	BTFSS	VAR1,7,A
	BCF	VAR2,3,A
	MOVF	VAR2,W,A
	MOVWF	PORTB

	GOTO	LBL1

SAVEF	MOVWF	POSTINC0
	MOVWF	POSTINC0
	MOVWF	POSTINC0
	MOVWF	POSTINC0
	MOVWF	POSTINC0
	MOVWF	POSTINC0
	MOVWF	POSTINC0
	MOVWF	POSTINC0
	MOVWF	POSTINC0
	MOVWF	POSTINC0
	MOVWF	POSTINC0
	MOVWF	POSTINC0
	MOVWF	POSTINC0
	MOVWF	POSTINC0
	MOVWF	POSTINC0
	MOVWF	POSTINC0
	MOVWF	POSTINC0
	MOVWF	POSTINC0
	MOVWF	POSTINC0
	MOVWF	POSTINC0
	MOVWF	POSTINC0


	BREAK	10H		;BREAK HERE TO CHECK THE DATA RAM WITH 
				;INSIDER cmd: DF0.10F 2F0.30F 7F0.80F BF0.C0F(CR)


	MOVWF	POSTINC0
	MOVWF	POSTINC0
	MOVWF	POSTINC0
	MOVWF	POSTINC0
	MOVWF	POSTINC0
	MOVWF	POSTINC0
	MOVWF	POSTINC0
	MOVWF	POSTINC0
	MOVWF	POSTINC0
	MOVWF	POSTINC0
	MOVWF	POSTINC0
	RETURN

;**************************************************************
; DELAY @32MHz


DL1MS	MOVLW	1	;DELAY 1ms
DLYMS	MOVWF	DLYH,A	;DELAY Wx1ms
DLY1	CLRF	DLYL,A
DLY2	RCALL	DLY3
	RCALL	DLY3
	RCALL	DLY3
	RCALL	DLY3
	RCALL	DLY3
	RCALL	DLY3
	RCALL	DLY3
	NOP
	DECFSZ	DLYL,1,A
	BRA	DLY2
	DECFSZ	DLYH,1,A
	BRA	DLY1
DLY3	RETURN




;************************************************************************
 IF DBRK==1	;DBUG18F: -- DEBUG INSIDER -- TARGET ROUTINE VR 1.1

DB0	EQU	0F7FH
DB1	EQU	0F7EH
DB2	EQU	0F7DH
DB3	EQU	0F7CH
DB4	EQU	0F7BH
DB5	EQU	0F7AH

;************** USER-PROG DEBUG PIN/PORT INITIALIZED FOR DIGITAL I/O
#DEFINE X	PORTD,2		;DEBUG PORT    -- USER SELECTED CPU PORT-REG-PIN
#DEFINE T	TRISD,2		;TRIS REG NAME -- USER SELECTED CPU TRIS-REG-PIN
DBN	EQU	.1	   	;SPEED MULTIPLIER: 1x, 2x, 4x, 8x, 16x

	ORG	0x10000-.378	;USER SELECTED END_PROG_MEM - DBUG(BYTES)
;CHECK CPU TYPE - BE CAREFUL WITH CONFIG-BYTES AT THE END OF PROG-MEM


DBUG	MOVFF	INTCON,DB1
	BCF	INTCON,GIE
	MOVFF	STATUS,DB2
	MOVFF	FSR0L,DB3
	MOVFF	FSR0H,DB4
DG001	MOVWF	FSR0L
	BSF	X
	BCF	T
	MOVLW	.10
	MOVWF	FSR0H
	RCALL	DG003
	RLCF	FSR0L
	BRA	DG005
DG002	RRCF	FSR0L
	MOVLW	.258-.127/DBN
	BTFSS	STATUS,C
DG003	MOVLW	.258-.63/DBN
	CLRWDT
	ADDLW	1
	BNZ	$-4
	RETURN
DG004	RCALL	DG002
DG005	BTG	X
	CLRWDT
	DECFSZ	FSR0H
	BRA	DG004
DG006	BSF	T
	RCALL	DG024
	BTFSS	FSR0L,7
	BRA	DG011
	BTFSC	FSR0L,6
	BRA	DG009
	BTFSS	FSR0L,5
	BRA	DG007
	RCALL	DG008
	MOVFF	WREG,DB0
	MOVLW	0FFH
	BRA	DBUG
DG007	BTFSS	FSR0L,4
	BRA	DG010
	MOVLW	DBN
	BRA	DG001
DG008	INCF	STKPTR
DG009	MOVF	FSR0L,W
	MOVWF	TOSU
	RCALL	DG024
	MOVF	FSR0L,W	
	MOVWF	TOSH
	RCALL	DG024
	BCF	FSR0L,0
	MOVF	FSR0L,W
	MOVWF	TOSL
DG010	MOVFF	DB0,WREG
	MOVFF	DB4,FSR0H
	MOVFF	DB3,FSR0L
	MOVFF	DB2,STATUS
	MOVFF	DB1,INTCON
	RETURN
DG011	MOVFF	FSR0L,DB5
	BTFSC	FSR0L,4
	BTFSS	FSR0L,5
	BRA	DG012
	RCALL	DG024
 IFDEF	EEADRH
	MOVFF	EEADRH,FSR0H
	MOVFF	DB5,EEADRH
 ELSE
	NOP
	NOP
	NOP
	NOP
 ENDIF
	MOVFF	EEADR,DB5
	MOVFF	FSR0L,EEADR
	MOVFF	EEDATA,FSR0L
	MOVF	EECON1,W
	BCF	EECON1,7
	BCF	EECON1,6
	BSF	EECON1,0
	MOVWF	EECON1
 IFDEF	EEADRH
	MOVFF	FSR0H,EEADRH
 ELSE
	NOP
	NOP
 ENDIF
	MOVFF	DB5,EEADR
	MOVF	EEDATA,W
	MOVFF	FSR0L,EEDATA
	BRA	DG001
DG012	BTFSC	FSR0L,4
	BRA	DG013
	BTFSC	FSR0L,5
	BRA	DG015
	RCALL	DG024
	MOVFF	DB5,WREG
	XORLW	HIGH WREG
	ANDLW	0FH
	BNZ	DG019
	MOVF	FSR0L,W
	XORLW	LOW WREG
	BNZ	DG014
DG013	MOVLW	LOW DB0
	BRA	DG021
DG014	XORLW	LOW STATUS^LOW WREG
	BNZ	DG016
DG015	MOVLW	LOW DB2
	BRA	DG021
DG016	XORLW	LOW INTCON^LOW STATUS
	BNZ	DG017
	MOVLW	LOW DB1
	BRA	DG021
DG017	XORLW	LOW FSR0L^LOW INTCON
	BNZ	DG018
	MOVLW	LOW DB3
	BRA	DG021
DG018	XORLW	LOW FSR0H^LOW FSR0L
	BNZ	DG019
	MOVLW	LOW DB4
	BRA	DG021
DG019	MOVFF	DB5,WREG
	XORLW	HIGH DB0
	ANDLW	0FH
	BNZ	DG022
	MOVF	FSR0L,W
	XORLW	LOW DB0
	BZ	DG020
	XORLW	LOW DB1^LOW DB0
	BZ	DG020
	XORLW	LOW DB2^LOW DB1
	BZ	DG020
	XORLW	LOW DB3^LOW DB2
	BZ	DG020
	XORLW	LOW DB4^LOW DB3
	BNZ	DG022
DG020	MOVLW	LOW DB5
DG021	MOVWF	FSR0L
	MOVFF	DB5,WREG
	ANDLW	0F0H
	IORLW	HIGH DB5
	MOVFF	WREG,DB5
DG022	MOVFF	DB5,FSR0H
	MOVFF	DB5,WREG
	BTFSS	WREG,6
	BRA	DG023
	MOVFF	FSR0L,DB5
	RCALL	DG024
	MOVF	FSR0L,W
	MOVFF	DB5,FSR0L
	MOVWF	INDF0
	BRA	DG006
DG023	MOVF	INDF0,W
	BRA	DG001
DG024	CLRF	FSR0L
	CLRWDT
	BTFSC	X
	BRA	$-4
	BRA	DG026
DG025	CLRF	WREG
	CLRWDT
	ADDLW	1
	BTFSC	X
	BRA	$-6
	ADDLW	.256-.78/DBN
	RRCF	FSR0L
DG026	CLRF	WREG
	CLRWDT
	ADDLW	1
	BTFSS	X
	BRA	$-6
	ADDLW	.256-.78/DBN
	RRCF	FSR0L
	BNC	DG025
	RETURN	
 ENDIF

	END
