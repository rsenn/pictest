;PROGRAM DEMO_16F88 4K CODE

 list		p=16F88, st=OFF
 #include	<p16F88.inc>
 errorlevel	-302
 errorlevel	-305
 errorlevel	-306	;TO AVOID "Message[306]: Crossing page boundary -- ensure page bits are set."
 radix	dec

 __CONFIG _CONFIG1, _CP_OFF & _CCP1_RB0 & _DEBUG_OFF & _WRT_PROTECT_OFF & _CPD_OFF & _LVP_OFF & _BODEN_OFF & _MCLR_OFF & _PWRTE_ON & _WDT_OFF & _INTRC_CLKOUT
 __CONFIG _CONFIG2, _IESO_OFF & _FCMEN_OFF


;************************************************************************
DBRK	EQU	1	;SET BREAKPOINTS-DEBUG ON/OFF 1/0
DBEE	EQU	1	;SET EEPROM-READ-CMD   ON/OFF 1/0

 IF DBRK==1
;************** DBUG-DATA-ADR AT 16Fxxx UNUSED BANK-0 DATA AREA
DB0	EQU	7FH	;DEBUG BYTE 0  COMMON ACCESS AREA
DB1	EQU	7EH	;DEBUG BYTE 1  COMMON ACCESS AREA
DB2	EQU	6FH	;DEBUG BYTE 2
DB3	EQU	6EH	;DEBUG BYTE 3
DB4	EQU	6DH	;DEBUG BYTE 4
DB5	EQU	6CH	;DEBUG BYTE 5

;************** USER-PROG INITIALIZED DEBUG PIN/PORT FOR DIGITAL I/O
#DEFINE X	PORTA,1	;DEBUG PORT    -- USER SELECTED CPU PORT-REG-PIN
#DEFINE T	TRISA,1	;TRIS REG NAME -- USER SELECTED CPU TRIS-REG-PIN
DBN	EQU	.4	;SPEED MULTIPLIER: 1x, 2x, 4x, 8x, 16x
 ENDIF

;************** DEBUG MACROS
 noexpand
BREAK	MACRO	bkn	;BREAKPOINT MACRO DEF
 IF DBRK==1
	MOVWF	DB0
	MOVLW	bkn
	CALL	DBUG
	BTFSC	DB1,6
	GOTO	DBGF
 ENDIF
	ENDM


;************************************************************************
;************************************************************************
; DEMO PROGRAM THAT LOADS BYTE 55H TO DATA RAM ADDRESS 20H-2FH,
; BYTE 69H TO DATA RAM ADDRESS A0H-AFH, BYTE 73H TO DATA RAM ADDRESS 120H-12FH
; TO TEST THE INSIDER DISPLAY (D cmd)
; THEN THERE IS LOOP WHERE PORTB BITS:4-5-6-7 CONNECTED TO 4x PUSHBUTTONS ARE
; READ AND IF ANY IS PRESSED (0-INPUT) THE CORRESPONDING LED CONNECTED TO
; PORTB 0-1-2-3 IS TURNED ON.

VAR1	EQU	20H
VAR2	EQU	21H
TMP	EQU	22H

;**************************************************************

	ORG	00H		;PAGE0

START	BSF	STATUS,RP0	;SET RBANK1
	MOVLW	01110000B	;SET 8MHz INTRC
	MOVWF	OSCCON

	MOVLW	00H
	MOVWF	ANSEL		;SET PORTA DIGITAL
	MOVLW	0F0H
	MOVWF	TRISB		;RB7-4 INPUT, RB3-0 OUTPUT
	MOVLW	0FFH
	MOVWF	TRISA
	BCF	STATUS,RP0	;SET RBANK0

	MOVLW	0FFH		;INIT PORTS
	MOVWF	PORTA
	MOVLW	0FFH
	MOVWF	PORTB

	MOVLW	20H
	MOVWF	FSR
	MOVLW	55H		;LOAD 55H -> 20H-2FH
	MOVWF	TMP

	PAGESEL	SAVE	;CHANGE CODE FROM PAGE0 TO PAGE1 TO EXECUTE SAVE ROUTINE

	CALL	SAVE
	CALL	SAVE
	CALL	SAVE
	CALL	SAVE
	CALL	SAVE
	CALL	SAVE
	CALL	SAVE
	CALL	SAVE
	CALL	SAVE
	CALL	SAVE

	PAGESEL	START	;BACK TO PAGE0 IN ORDER TO EXECUTE THE BREAKPOINT

	BREAK	17H		;BREAK HERE TO CHECK THE DATA RAM WITH 
				;INSIDER cmd: D20.2F A0.AF 120.12F(CR)

	PAGESEL	SAVE	;CHANGE CODE FROM PAGE0 TO PAGE1 TO EXECUTE SAVE ROUTINE

	CALL	SAVE
	CALL	SAVE
	CALL	SAVE
	CALL	SAVE
	CALL	SAVE
	CALL	SAVE

	PAGESEL	START	;BACK TO PAGE0

	MOVLW	0A0H
	MOVWF	FSR
	MOVLW	69H		;LOAD 69H -> A0H-AFH
	MOVWF	TMP

	PAGESEL	SAVE	;CHANGE CODE FROM PAGE0 TO PAGE1 TO EXECUTE SAVE ROUTINE

	CALL	SAVE
	CALL	SAVE
	CALL	SAVE
	CALL	SAVE
	CALL	SAVE
	CALL	SAVE
	CALL	SAVE

	PAGESEL	START	;BACK TO PAGE0 IN ORDER TO EXECUTE THE BREAKPOINT

	BREAK	18H		;BREAK HERE TO CHECK THE DATA RAM WITH 
				;INSIDER cmd: D20.2F A0.AF 120.12F(CR)

	PAGESEL	SAVE	;CHANGE CODE FROM PAGE0 TO PAGE1 TO EXECUTE SAVE ROUTINE

	CALL	SAVE
	CALL	SAVE
	CALL	SAVE
	CALL	SAVE
	CALL	SAVE
	CALL	SAVE
	CALL	SAVE
	CALL	SAVE
	CALL	SAVE

	PAGESEL	START	;BACK TO PAGE0 IN ORDER TO EXECUTE THE BREAKPOINT

	BREAK	19H		;BREAK HERE TO CHECK THE DATA RAM WITH 
				;INSIDER cmd: D20.2F A0.AF 120.12F(CR)

	MOVLW	20H
	BSF	STATUS,IRP	;SET BANK2-3
	MOVWF	FSR
	MOVLW	73H		;LOAD 73H -> 120H-12FH
	MOVWF	TMP


	PAGESEL	SAVE	;CHANGE CODE FROM PAGE0 TO PAGE1 TO EXECUTE SAVE ROUTINE

	CALL	SAVE
	CALL	SAVE
	CALL	SAVE
	CALL	SAVE
	CALL	SAVE
	CALL	SAVE
	CALL	SAVE
	CALL	SAVE
	CALL	SAVE
	CALL	SAVE
	CALL	SAVE
	CALL	SAVE
	CALL	SAVE
	CALL	SAVE
	CALL	SAVE
	CALL	SAVE

				;PAGESEL ALREADY SET TO PAGE1
	GOTO	LBL1		;TO CHECK THE INSIDER MULTIPAGE FUNCTIONALITY


	ORG	800H		;PAGE1

LBL1	MOVF	PORTB,W		;READ KEY PRESS -> BIT 4-7


	BREAK	20H		;BREAK HERE TO CHECK THE DATA RAM WITH 
				;INSIDER cmd: D(CR)

	MOVWF	VAR1
	IORLW	0FH
	XORLW	0FFH
	SKPNZ
	GOTO	LBL1
	BCF	STATUS,C
	BCF	STATUS,DC


	BREAK	31H		;BREAK HERE AFTER ANY KEY PRESSED IN W


	MOVLW	0FFH
	MOVWF	VAR2		;SET VAR2-> FFH
	BTFSS	VAR1,4		;SET LEDS
	BCF	VAR2,0
	BTFSS	VAR1,5
	BCF	VAR2,1
	BTFSS	VAR1,6
	BCF	VAR2,2
	BTFSS	VAR1,7
	BCF	VAR2,3
	MOVF	VAR2,W
	MOVWF	PORTB
	GOTO	LBL1

SAVE	MOVF	TMP,W		;CALLF THIS ROUTINE WITH BREAK 40H DISABLE

	BREAK	40H		;DISABLE AND ENABLE THIS BREAK TO SEE THE CALLF CMD BEHAVIOR

	MOVWF	INDF
	INCF	FSR
	RETURN



;******************************************************************

 IF DBRK==1	;16FDBUG: -- DEBUG INSIDER -- TARGET ROUTINE VR 1.2

	ORG	0x800-8
	MOVWF	DB1		;SWITCH ROUTINE PAGE-0
	MOVF	STATUS,W	;CHECK PIC PROG-MEMORY-SIZE
	CLRF	STATUS
	MOVWF	DB2
	MOVF	PCLATH,W
	PAGESEL	DBUG
	GOTO	DBGX

ENDPROG	EQU	0x1000	   	;LAST 2K-PAGE-END-PROG-MEM
				;CHECK PIC PROG-MEMORY-SIZE
	ORG	ENDPROG-.160
 IF DBEE
 IFDEF	EECON1
	ORG	ENDPROG-.184
 ENDIF
 ENDIF

DBGY	BCF	INTCON,GIE
	MOVWF	DB4
	MOVF	FSR,W
	MOVWF	DB3
DG001	BSF	X
	BSF	STATUS,RP0
	BCF	T
	CLRF	STATUS
	MOVLW	.251
	MOVWF	FSR
	CALL	DG003
	RLF	DB1
	GOTO	DG006
DG002	RRF	DB1
	MOVLW	.258-.127/DBN
	BTFSS	STATUS,C
DG003	MOVLW	.258-.63/DBN
	ADDLW	1
	BTFSS	STATUS,Z
	GOTO	$-2
DG004	RETURN
DG005	CALL	DG002
DG006	BCF	X
	CALL	DG004
	CALL	DG002
	BSF	X
	CLRWDT
	INCFSZ	FSR
	GOTO	DG005
DG007	BSF	STATUS,RP0
	BSF	T
	CLRF	STATUS
	CALL	DG017
	BTFSS	DB1,7
	GOTO	DG009
	BTFSC	DB1,6
	RETURN
	BTFSS	DB1,5
	GOTO	$+5
	CALL	DBGF
	MOVWF	DB0
	MOVLW	0FFH
	GOTO	DBUG
	MOVLW	DBN
	BTFSC	DB1,4
	GOTO	DG016
	MOVF	DB5,W
	MOVWF	PCLATH
DG008	MOVF	DB3,W
	MOVWF	FSR
	MOVF	DB4,W
	MOVWF	INTCON
	MOVF	DB2,W
	MOVWF	STATUS
	SWAPF	DB0
	SWAPF	DB0,W
	RETURN
DBGF	CALL	DG017
	MOVF	DB1,W
	MOVWF	DB0
	CALL	DG017
	CALL	DG008
	MOVWF	PCLATH
	SWAPF	DB1
	SWAPF	DB1,W
	MOVWF	PCL
DG009	BTFSC	DB1,4
	BTFSS	DB1,5
	GOTO	DG010
	CALL	DG017
 IF DBEE
 IFDEF	EECON1
	BANKSEL	EEADR
	MOVF	EEADR,W
	MOVWF	FSR
	MOVF	DB1,W
	MOVWF	EEADR
	MOVF	EEDATA,W
	MOVWF	DB1
	BANKSEL	EECON1
	MOVF	EECON1,W
	BCF	EECON1,7
	BSF	EECON1,0
	MOVWF	EECON1
	BANKSEL	EEADR
	MOVF	EEDATA,W
	XORWF	DB1
	XORWF	DB1,W
	XORWF	DB1
	MOVWF	EEDATA
	MOVF	FSR,W
	MOVWF	EEADR
	CLRF	STATUS
 ENDIF
 ENDIF
	GOTO	DG001
DG010	MOVF	DB1,W
	MOVWF	FSR
	MOVLW	DB0
	BTFSC	DB1,4
	GOTO	DG014
	BTFSC	DB1,5
	GOTO	DG011
	CALL	DG017
	MOVLW	7FH
	ANDWF	DB1,W
	XORLW	STATUS
	BTFSS	STATUS,Z
	GOTO	$+3
DG011	MOVLW	DB2
	GOTO	DG014
	XORLW	FSR^STATUS
	BTFSS	STATUS,Z
	GOTO	$+3
	MOVLW	DB3
	GOTO	DG014
	XORLW	INTCON^FSR
	BTFSS	STATUS,Z
	GOTO	$+3
	MOVLW	DB4
	GOTO	DG014
	XORLW	PCLATH^INTCON
	BTFSS	STATUS,Z
	GOTO	$+3
	MOVLW	DB5
	GOTO	DG014
	XORLW	DB0^PCLATH
	BTFSC	STATUS,Z
	GOTO	DG012
	BTFSS	FSR,0
	BTFSC	DB1,7
	GOTO	DG013
	XORLW	DB2^DB0
	BTFSS	STATUS,Z
	XORLW	DB3^DB2
	BTFSS	STATUS,Z
	XORLW	DB4^DB3
	BTFSS	STATUS,Z
	XORLW	DB5^DB4
DG012	MOVLW	DB1
	BTFSS	STATUS,Z
DG013	MOVF	DB1,W
	BTFSC	FSR,0
	BSF	STATUS,IRP
DG014	BTFSS	FSR,6
	GOTO	DG015
	MOVWF	FSR
	CALL	DG017
	MOVF	DB1,W
	MOVWF	INDF
	GOTO	DG007
DG015	MOVWF	FSR
	MOVF	INDF,W
DG016	MOVWF	DB1
	GOTO	DG001
DG017	CLRF	DB1
	CLRWDT
	BTFSC	X
	GOTO	$-2
	GOTO	DG019
DG018	CLRW
	CLRWDT
	ADDLW	1
	BTFSC	X
	GOTO	$-3
	ADDLW	.256-.78/DBN
	RRF	DB1
DG019	CLRW
	CLRWDT
	ADDLW	1
	BTFSS	X
	GOTO	$-3
	ADDLW	.256-.78/DBN
	RRF	DB1
	BTFSS	STATUS,C
	GOTO	DG018
	RETURN
DBUG	MOVWF	DB1
	MOVF	STATUS,W
	CLRF	STATUS
	MOVWF	DB2
	MOVF	PCLATH,W
DBGX	MOVWF	DB5
	MOVF	INTCON,W
	GOTO	DBGY

 ENDIF
	END
