;PROGRAM DEMO_12F629

 list      p=12f629, st=OFF
 #include  <p12f629.inc>
 errorlevel  -302
 errorlevel  -305
 radix	dec

 __CONFIG   _CP_OFF & _CPD_OFF & _BODEN_OFF & _MCLRE_OFF & _WDT_OFF & _PWRTE_ON & _INTRC_OSC_NOCLKOUT

DBRK	EQU	1	;SET BREAKPOINTS-DEBUG ON/OFF 1/0
DBEE	EQU	1	;SET EEPROM-READ-CMD   ON/OFF 1/0
 noexpand

BREAK	MACRO	bkn	;BREAKPOINT MACRO DEF
 IF DBRK==1
	MOVWF	DB0
	MOVLW	bkn
	CALL	DBUG
	BTFSC	DB1,6
	GOTO	DBGF
 ENDIF
	ENDM

	ORG	00H

;************************************************************************
; DEMO PROGRAM THAT LOADS BYTE 55H TO DATA RAM ADDRESS 30H-3FH,
; BYTE 69H TO DATA RAM ADDRESS 40H-4FH, TO TEST THE INSIDER DISPLAY (D cmd)
; THEN THERE IS LOOP WHERE GPIO BITS:3-4-5 CONNECTED TO 3x PUSHBUTTONS ARE
; READ AND IF ANY IS PRESSED (0-INPUT) THE CORRESPONDING LED CONNECTED TO
; GPIO 0-1-2 IS TURNED ON.

VAR1	EQU	20H
VAR2	EQU	21H
TMP	EQU	22H

;**************************************************************

START	BSF	STATUS,RP0	;INTERNAL OSCILATOR CAL VALUE @4MHz
	CALL	3FFH		;1us INSTRUCTION CYCLE
	MOVWF	OSCCAL

	BCF	STATUS,RP0
	MOVLW	07H		;DIGITAL MODE ON GPIO 0,1,2
	MOVWF	CMCON
	MOVLW	0FFH
	MOVWF	GPIO		;INIT PORT '1'

	BSF	STATUS,RP0
	MOVLW	0F8H		;GPI0: 0-1-2-OUT 3-4-5-INPUT
	MOVWF	TRISIO		;NOTE THAT GPIO,2 WILL BE SHARED WITH
	BCF	STATUS,RP0	;THE INSIDER 1BIT INTERFACE

;*****************************************************

	MOVLW	30H
	MOVWF	FSR
	MOVLW	55H		;LOAD 55H -> 30H-3FH
	MOVWF	TMP

	CALL	SAVE
	CALL	SAVE
	CALL	SAVE
	CALL	SAVE
	CALL	SAVE
	CALL	SAVE
	CALL	SAVE
	CALL	SAVE
	CALL	SAVE

	BREAK	18H		;BREAK HERE TO CHECK THE DATA RAM WITH 
				;INSIDER cmd: D30.4F(CR)

	CALL	SAVE
	CALL	SAVE
	CALL	SAVE
	CALL	SAVE
	CALL	SAVE
	CALL	SAVE
	CALL	SAVE

	MOVLW	40H
	MOVWF	FSR
	MOVLW	69H		;LOAD 69H -> 40H-4FH
	MOVWF	TMP

	CALL	SAVE
	CALL	SAVE
	CALL	SAVE
	CALL	SAVE

	BREAK	19H		;BREAK HERE TO CHECK THE DATA RAM WITH 
				;INSIDER cmd: D30.4F(CR)

	CALL	SAVE
	CALL	SAVE
	CALL	SAVE
	CALL	SAVE
	CALL	SAVE
	CALL	SAVE
	CALL	SAVE
	CALL	SAVE
	CALL	SAVE
	CALL	SAVE
	CALL	SAVE
	CALL	SAVE

LBL1	MOVF	GPIO,W		;READ KEY PRESS -> BIT 3-5

	BREAK	20H		;BREAK HERE TO CHECK THE DATA RAM WITH 
				;INSIDER cmd: D(CR)

	MOVWF	VAR1
	IORLW	0C7H
	XORLW	0FFH
	SKPNZ
	GOTO	LBL1
	BCF	STATUS,C
	BCF	STATUS,DC

	BREAK	21H		;BREAK HERE AFTER ANY KEY PRESSED IN W


	MOVLW	0FFH
	MOVWF	VAR2		;SET VAR2-> FFH
	BTFSS	VAR1,3		;SET LEDS
	BCF	VAR2,0
	BTFSS	VAR1,4
	BCF	VAR2,1
	BTFSS	VAR1,5
	BCF	VAR2,2
	MOVF	VAR2,W
	MOVWF	GPIO
	GOTO	LBL1


SAVE	MOVF	TMP,W		;CALLF THIS ROUTINE WITH BREAK 40H DISABLE

	BREAK	40H		;DISABLE AND ENABLE THIS BREAK TO SEE THE CALLF CMD BEHAVIOR

	MOVWF	INDF
	INCF	FSR
	RETURN



;********************************************************************

 IF DBRK==1	;12FDBUG: -- DEBUG INSIDER -- TARGET ROUTINE VR 1.1

DB0	EQU	5FH	;COMMON ACCESS AREA
DB1	EQU	5EH	;COMMON ACCESS AREA
DB2	EQU	5DH	;BANK0
DB3	EQU	5CH	;BANK0
DB4	EQU	5BH	;BANK0

;************** USER-PROG INITIALIZED DEBUG PIN/PORT FOR DIGITAL I/O
P	EQU	2	;DEBUG PIN     -- USER SELECTED GPIO I/O-PIN
DBN	EQU	.1	;SPEED MULTIPLIER: 1x, 2x, 4x, 8x, 16x

ENDPROG	EQU	3FFH	;USER SELECTED END-PROG-MEM - CHECK CPU TYPE -
; ----- BE CAREFUL WITH OSCCAL/CONFIG BYTE AT THE END OF PROG-MEM ----

	ORG	ENDPROG-.144
 IF DBEE
 IFDEF	EECON1
	ORG	ENDPROG-.158
 ENDIF
 ENDIF

DBUG	MOVWF	DB1
	MOVF	STATUS,W
	CLRF	STATUS
	MOVWF	DB2
	MOVF	INTCON,W
	BCF	INTCON,GIE
	MOVWF	DB4
	MOVF	FSR,W
	MOVWF	DB3
DG001	BSF	GPIO,P
	BSF	STATUS,RP0
	BCF	TRISIO,P
	CLRF	STATUS
	MOVLW	.251
	MOVWF	FSR
	CALL	DG003
	RLF	DB1
	GOTO	DG006
DG002	RRF	DB1
	MOVLW	.258-.127/DBN
	BTFSS	STATUS,C
DG003	MOVLW	.258-.63/DBN
	ADDLW	1
	BTFSS	STATUS,Z
	GOTO	$-2
DG004	RETURN
DG005	CALL	DG002
DG006	BCF	GPIO,P
	CALL	DG004
	CALL	DG002
	BSF	GPIO,P
	CLRWDT
	INCFSZ	FSR
	GOTO	DG005
DG007	BSF	STATUS,RP0
	BSF	TRISIO,P
	CLRF	STATUS
	CALL	DG016
	BTFSS	DB1,7
	GOTO	DG009
	BTFSC	DB1,6
	RETURN
	BTFSS	DB1,5
	GOTO	$+5
	CALL	DBGF
	MOVWF	DB0
	MOVLW	0FFH
	GOTO	DBUG
	MOVLW	DBN
	BTFSC	DB1,4
	GOTO	DG015
DG008	MOVF	DB3,W
	MOVWF	FSR
	MOVF	DB4,W
	MOVWF	INTCON
	MOVF	DB2,W
	MOVWF	STATUS
	SWAPF	DB0
	SWAPF	DB0,W
	RETURN
DBGF	CALL	DG016
	MOVF	DB1,W
	MOVWF	DB0
	CALL	DG016
	CALL	DG008
	MOVWF	PCLATH
	SWAPF	DB1
	SWAPF	DB1,W
	MOVWF	PCL
DG009	BTFSC	DB1,4
	BTFSS	DB1,5
	GOTO	DG010
	CALL	DG016
 IF DBEE
 IFDEF	EECON1
	BSF	STATUS,RP0
	MOVF	EEADR,W
	MOVWF	FSR
	MOVF	DB1,W
	MOVWF	EEADR
	MOVF	EEDATA,W
	BSF	EECON1,0
	XORWF	EEDATA
	XORWF	EEDATA,W
	XORWF	EEDATA
	MOVWF	DB1
	MOVF	FSR,W
	MOVWF	EEADR
	CLRF	STATUS
 ENDIF
 ENDIF
	GOTO	DG001
DG010	MOVF	DB1,W
	MOVWF	FSR
	MOVLW	DB0
	BTFSC	DB1,4
	GOTO	DG013
	BTFSC	DB1,5
	GOTO	DG011
	CALL	DG016
	MOVLW	7FH
	ANDWF	DB1,W
	XORLW	STATUS
	BTFSS	STATUS,Z
	GOTO	$+3
DG011	MOVLW	DB2
	GOTO	DG013
	XORLW	FSR^STATUS
	BTFSS	STATUS,Z
	GOTO	$+3
	MOVLW	DB3
	GOTO	DG013
	XORLW	INTCON^FSR
	BTFSS	STATUS,Z
	GOTO	$+3
	MOVLW	DB4
	GOTO	DG013
	XORLW	DB0^INTCON
	BTFSC	STATUS,Z
	GOTO	DG012
	MOVF	DB1,W
	XORLW	DB2
	BTFSS	STATUS,Z
	XORLW	DB3^DB2
	BTFSS	STATUS,Z
	XORLW	DB4^DB3
DG012	MOVLW	DB1
	BTFSS	STATUS,Z
	MOVF	DB1,W
DG013	BTFSS	FSR,6
	GOTO	DG014
	MOVWF	FSR
	CALL	DG016
	MOVF	DB1,W
	MOVWF	INDF
	GOTO	DG007
DG014	MOVWF	FSR
	MOVF	INDF,W
DG015	MOVWF	DB1
	GOTO	DG001
DG016	CLRF	DB1
	CLRWDT
	BTFSC	GPIO,P
	GOTO	$-2
	GOTO	DG018
DG017	CLRW
	CLRWDT
	ADDLW	1
	BTFSC	GPIO,P
	GOTO	$-3
	ADDLW	.256-.78/DBN
	RRF	DB1
DG018	CLRW
	CLRWDT
	ADDLW	1
	BTFSS	GPIO,P
	GOTO	$-3
	ADDLW	.256-.78/DBN
	RRF	DB1
	BTFSS	STATUS,C
	GOTO	DG017
	RETURN

 ENDIF
;********************************************************************

	END
